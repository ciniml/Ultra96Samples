/include/ "system-conf.dtsi"
/include/ "openamp-overlay.dtsi"
/{
	chosen {
		stdout-path = "serial0:115200n8";
	};
	aliases {
		serial0 = &uart1;
		serial1 = &uart0;
	};
};

&debug_bridge_0 {
	compatible = "generic-uio";
};

